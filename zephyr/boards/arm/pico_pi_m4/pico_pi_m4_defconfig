## zephyr/boards/arm/pico_pi_m4/pico_pi_m4_defconfig
```kconfig
CONFIG_ARM=y
CONFIG_SOC_FAMILY_IMX=y
CONFIG_SOC_SERIES_IMX7_M4=y
CONFIG_SOC_MCIMX7_M4=y
CONFIG_BOARD_PICO_PI_M4=y
CONFIG_CORTEX_M_SYSTICK=y
CONFIG_SERIAL_HAS_DRIVER=y
CONFIG_UART_CONSOLE=y
CONFIG_SERIAL=y
CONFIG_CONSOLE=y
CONFIG_CONSOLE_HAS_DRIVER=y
CONFIG_XIP=y

#CHATGPT
#CONFIG_UART_INTERRUPT_DRIVEN=y
#CONFIG_UART_INTERRUPT_DRIVEN_ASYNC=y

#CONFIG_RPMSG_SERVICE_NAME="rpmsg-openamp-demo-channel"
#CONFIG_RPMSG_NS=y
#CONFIG_RPMSG_TTY=y
```
